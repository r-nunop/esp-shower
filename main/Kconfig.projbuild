## main/Kconfig.projbuild
```kconfig
menu "S-PockShower"
    config TB_URI
        string "URI del broker MQTT"
        default "mqtt://mqtt.eu.thingsboard.cloud"
    config TB_TOKEN
        string "Token del dispositivo ThingsBoard"
        default ""
    config OTA_URL
        string "URL del firmware OTA"
        default "https://github.com/r-nunop/esp-shower/releases/latest/download/S_PockShower.bin"
    config OTA_HORA_DIARIA
        int "Hora de la comprobacion diaria de OTA (hora de Madrid)"
        range 0 23
        default 3
    config SHOWER_LIGHT_SLEEP
        bool "Light sleep automatico en REPOSO"
        depends on PM_ENABLE && FREERTOS_USE_TICKLESS_IDLE
        default y
endmenu
```

## sdkconfig.defaults
```kconfig
CONFIG_PARTITION_TABLE_CUSTOM=y
CONFIG_PARTITION_TABLE_CUSTOM_FILENAME="partitions.csv"
CONFIG_MBEDTLS_CERTIFICATE_BUNDLE=y
CONFIG_ESPTOOLPY_FLASHSIZE_4MB=y
CONFIG_ESP_TASK_WDT_PANIC=y
CONFIG_ESP_TASK_WDT_TIMEOUT_S=5
```
